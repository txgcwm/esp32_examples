## iot/main/Kconfig.projbuild
```kconfig
menu "Iot configuration"

config SNTP_SERVER
    string "SNTP Server"
	default "pool.ntp.org"

config BUTTON_PIN
    int "Number of the PIN connected to the BUTTON"
	range 0 34
	default 0
	
config SERVER_IP
    string "HTTP Server IP"
	default "192.168.0.103"
	help
		HTTP Server IP to download the image file from.

		See example README.md for details.

config SERVER_PORT
	string "HTTP Server Port"
	default "8080"
	help
		HTTP Server port to connect to.
		Should be chosen not to conflict with any other port used
		on the system.

config EXAMPLE_FILENAME
	string "HTTP GET Filename"
	default "/ota.bin"
	help
		Filename of the app image file to download for
		the OTA update.

config SPIFFS_BASE_ADDR
    hex "SPIFFS Base address"
    range 100000 1FFE000
    default 180000
    help
	Starting address of the SPIFFS area in ESP32 Flash

config SPIFFS_SIZE
    int "SPIFFS Size in bytes"
    range 262144 2097152
    default 1048576

config SPIFFS_LOG_BLOCK_SIZE
    int "SPIFFS Logical block size"
    range 4098 65536
    default 8192

config SPIFFS_LOG_PAGE_SIZE
    int "SPIFFS Logical page size"
    range 256 2048
    default 256
    help
	Set it to the phisycal page size og the used SPI Flash chip.
	
endmenu
```
